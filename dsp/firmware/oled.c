/*
    bluxboxes dsp - Copyright (c) 2016-2020 David Turner
    Uses ChibiOS RT/HAL - Copyright (C) 2006..2016 Giovanni Di Sirio
    Based on OLED driver from Supervide - (C) 2015 Adam Greig

    blueboxes dsp is free software; you can redistribute it and/or modify
    it under the terms of the GNU General Public License as published by
    the Free Software Foundation; either version 3 of the License, or
    (at your option) any later version.

    blueboxes dsp is distributed in the hope that it will be useful,
    but WITHOUT ANY WARRANTY; without even the implied warranty of
    MERCHANTABILITY or FITNESS FOR A PARTICULAR PURPOSE.  See the
    GNU General Public License for more details.

    You should have received a copy of the GNU General Public License
    along with this program.  If not, see <http://www.gnu.org/licenses/>.
*/

#include "oled.h"
#include <ch.h>
#include <hal.h>
#include <string.h>

#define OLED_SPID     SPID2
#define OLED_CS_PORT  GPIOB
#define OLED_CS_PIN   GPIOB_OLED_CS

uint8_t oled_buffer[4][128];

static void oled_start(void);
static void oled_stop(void);

static uint8_t oled_init_cmds[] = {
    0xAE,       /* OLED panel off */
    0xD5, 0x70, /* Display clock divide: default freq, div by 1 */
    0xA8, 0x1F, /* MUX ratio: 32MUX (as 32 rows) */
    0xD3, 0x00, /* Display offset: not offset */
    0xD8, 0x05, /* Area Colour Mode: monochrome, low power mode */
    0xA0,       /* Segment remap: no left/right flip */
    0xC0,       /* COM scan direction: no top/bottom flip */
    0xDA, 0x12, /* COM pins hardware config: L/R remap + alt config */
    0x91, 0x3F, 0x3F, 0x3F, 0x3F, /* Current drive pulse widths */
    0xD9, 0x22, /* Pre-charge period: default values (example is 0xD2) */
    0xDB, 0x34, /* VCOMH: 0.77 * VCC (default) */
    0xA6,       /* Normal (not inverse) display */
    0xA4,       /* Disable entire display ON */
    0x20, 0x00, /* Memory addressing mode: horizontal */
    0x21, 0, 127, /* Start at column 4, end at column 131 (NB 0xA1 remap) */
    0x22, 0x00, 0x03, /* Start page 0, end at page 3 (as 4 rows of 8 pix) */
    0x81, 0xFF, /* Contrast control: maximum contrast */
    0x82, 0xFF, /* Set maximum brightness for colour banks */
    0xAD, 0x8F, /* Master configuration: DC-DC enabled */
    0xAF,       /* OLED panel on, normal (not dim) mode */
};

static const uint8_t oled_font[96][6] = {
	{0x00,0x00,0x00,0x00,0x00,0x00}, //  
	{0x2e,0x00,0x00,0x00,0x00,0x00}, // !
	{0x06,0x00,0x06,0x00,0x00,0x00}, // "
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	{0x00,0x00,0x00,0x00,0x00,0x00}
};

static const SPIConfig oled_spi_cfg = {
  .end_cb = NULL,
  .ssport = GPIOB,
  .sspad = GPIOB_LCD_CS,
  .cr1 = SPI_CR1_BR_2 | SPI_CR1_CPOL | SPI_CR1_CPHA
};

static void oled_start(void)
{
    spiStart(&OLED_SPID, &oled_spi_cfg);
}

static void oled_stop(void)
{
    spiStop(&OLED_SPID);
}

static const uint8_t oled_nibble_stretch[16] = {
    0x00, 0x03, 0x0c, 0x0f, 0x30, 0x33, 0x3c, 0x3f,
    0xc0, 0xc3, 0xcc, 0xcf, 0xf0, 0xf3, 0xfc, 0xff
};

void oled_init() {
    /* Reset OLED */
    palClearLine(LINE_LCD_RESET);
    palSetLine(LINE_LCD_CS);
    chThdSleepMilliseconds(1000);
    palSetLine(LINE_LCD_RESET);

    oled_start();

    /* Send initialisation commands */
    palClearLine(LINE_LCD_DC);
    palClearLine(LINE_LCD_CS);
    spiSend(&OLED_SPID, sizeof(oled_init_cmds), (void*)oled_init_cmds);
    palSetLine(LINE_LCD_CS);

    oled_stop();
}

// void oled_logo() {
//     memcpy(oled_buffer, oled_sv_logo, sizeof(oled_sv_logo));
// }

void oled_icon(const uint8_t* icon)
{
    int x, y;
    if(icon == NULL)
        for(y=0; y<4; y++)
            for(x=0; x<40; x++)
                oled_buffer[3-y][x+88] = 0;
    else
        for(y=0; y<4; y++)
            for(x=0; x<40; x++)
                oled_buffer[3-y][x+88] = *(icon + y*40 + x);
}

void oled_erase() {
    memset(oled_buffer, 0, sizeof(oled_buffer));
}

void oled_text_small(uint8_t line, uint8_t x, const char* str)
{
    int i, j;
    int len = strnlen(str, 21-x);
    
    if(line > 3)
        line = 0;

    if(x > 20)
        x = 0;

    for(i=0; i<len; i++) {
        char c = str[i];
        if(c < ' ' || c > '~')
            c = 0;
        else
            c -= ' ';
        
        for(j=0; j<6; j++) {
            oled_buffer[line][1+(x+i)*6+j] = oled_font[(int)c][j];
        }
    }
}

void oled_text_big(uint8_t line, uint8_t x, const char* str)
{
    int i, j;
    int len = strnlen(str, 10-x);
    
    if(line > 1)
        line = 0;

    if(x > 9)
        x = 0;

    for(i=0; i<len; i++) {
        char c = str[i];
        if(c < ' ' || c > '~')
            c = 0;
        else
            c -= ' ';

        for(j=0; j<6; j++) {
            oled_buffer[line*2+0][1+(x+i)*12+j*2+0] =
                oled_nibble_stretch[oled_font[(int)c][j] & 0x0F];
            oled_buffer[line*2+0][1+(x+i)*12+j*2+1] =
                oled_nibble_stretch[oled_font[(int)c][j] & 0x0F];
            oled_buffer[line*2+1][1+(x+i)*12+j*2+0] =
                oled_nibble_stretch[oled_font[(int)c][j] >> 4];
            oled_buffer[line*2+1][1+(x+i)*12+j*2+1] =
                oled_nibble_stretch[oled_font[(int)c][j] >> 4];
        }
    }
}

void oled_draw()
{
    oled_start();

    /* Write the buffer to the OLED */
    palClearLine(LINE_LCD_DC);
    palSetLine(LINE_LCD_DC);
    palClearLine(LINE_LCD_CS);
    spiSend(&OLED_SPID, sizeof(oled_buffer), (void*)oled_buffer);
    palSetLine(LINE_LCD_CS);

    oled_stop();
}
